## App/Kconfig
```kconfig
# Kconfig file for Tactility example app
menu "Tactility App"
    config TT_BOARD_NAME
        string "Board Name"
        default ""
    config TT_BOARD_ID
        string "Board ID"
        default ""
    choice
        prompt "Board"
        default TT_BOARD_CUSTOM
        config TT_BOARD_CUSTOM
            bool "Custom"
        config TT_BOARD_CYD_2432S022C
            bool "CYD 2432S022C"
        config TT_BOARD_CYD_2432S024C
            bool "CYD 2432S024C"
        config TT_BOARD_CYD_2432S028R
            bool "CYD 2432S028R"
        config TT_BOARD_CYD_E32R28T
            bool "CYD E32R28T"    
        config TT_BOARD_CYD_2432S032C
            bool "CYD 2432S032C"
        config TT_BOARD_CYD_8048S043C
            bool "CYD 8048S043C"
        config TT_BOARD_CYD_JC2432W328C
            bool "CYD JC2432W328C"
        config TT_BOARD_CYD_JC8048W550C
            bool "CYD JC8048W550C"
        config TT_BOARD_CYD_4848S040C
            bool "CYD 4848S040C"
        config TT_BOARD_ELECROW_CROWPANEL_ADVANCE_28
            bool "Elecrow CrowPanel Advance 2.8"
        config TT_BOARD_ELECROW_CROWPANEL_ADVANCE_35
            bool "Elecrow CrowPanel Advance 3.5"
        config TT_BOARD_ELECROW_CROWPANEL_ADVANCE_50
            bool "Elecrow CrowPanel Advance 5.0"
        config TT_BOARD_ELECROW_CROWPANEL_BASIC_28
            bool "Elecrow CrowPanel Basic 2.8"
        config TT_BOARD_ELECROW_CROWPANEL_BASIC_35
            bool "Elecrow CrowPanel Basic 3.5"
        config TT_BOARD_ELECROW_CROWPANEL_BASIC_50
            bool "Elecrow CrowPanel Basic 5.0"
        config TT_BOARD_LILYGO_TDECK
            bool "LilyGo T-Deck"
        config TT_BOARD_LILYGO_TLORA_PAGER
            bool "LilyGo T-Lora Pager"
        config TT_BOARD_M5STACK_CORE2
            bool "M5Stack Core2"
        config TT_BOARD_M5STACK_CORES3
            bool "M5Stack CoreS3"
        config TT_BOARD_UNPHONE
            bool "unPhone"
        config TT_BOARD_WAVESHARE_S3_TOUCH_43
            bool "Waveshare ESP32 S3 Touch LCD 4.3"
        help
            Select a board/hardware configuration.
            Use TT_BOARD_CUSTOM if you will manually configure the board in your project.
    endchoice

    config TT_SPLASH_DURATION
        int "Splash Duration (ms)"
        default 1000
        range 0 3000
        help
            The minimum time to show the splash screen in milliseconds.
            When set to 0, startup will continue to desktop as soon as boot operations are finished.
endmenu
```

## Drivers/XPT2046-SoftSPI-Old/esp_lcd_touch_xpt2046/Kconfig.projbuild
```kconfig
menu "XPT2046"
    config XPT2046_Z_THRESHOLD
        int "Minimum Z pressure threshold"
        default 400
        help
            Touch pressure less than this value will be discarded as invalid
            and no touch position data collected.

    config XPT2046_INTERRUPT_MODE
        bool "Enable Interrupt (PENIRQ) output"
        default n
        help
            Also called Full Power Mode.
            Enable this to configure the XPT2046 to output low on the PENIRQ output
            if a touch is detected.
            This mode uses more power when enabled.
            Note that this signal goes low normally when a read is active.

    config XPT2046_VREF_ON_MODE
        bool "Keep internal Vref enabled"
        default n
        help
            Enable this to keep the internal Vref enabled between conversions.
            This uses slightly more power, but requires fewer transactions when
            reading the battery voltage, aux voltage and temperature.

    config XPT2046_CONVERT_ADC_TO_COORDS
        bool "Convert touch coordinates to screen coordinates"
        default y
        help
            When this option is enabled the raw ADC values will be converted from
            0-4096 to 0-{screen width} or 0-{screen height}.
            When this option is disabled the process_coordinates method will need
            to be used to convert the raw ADC values into a screen coordinate.

    config XPT2046_ENABLE_LOCKING
        bool "Enable data structure locking"
        default n
        help
            By enabling this option the XPT2046 driver will lock the touch position
            data structures when reading values from the XPT2046 and when reading
            position data via API.
            WARNING: enabling this option may result in unintended crashes.
endmenu
```

## Firmware/Kconfig.template
```kconfig
# Firmware/Kconfig.template
# Template for Kconfig - run generate_boards.py to update Firmware/Kconfig
menu "Tactility App"
    config TT_BOARD_NAME
        string "Board Name"
        default ""
    config TT_BOARD_ID
        string "Board ID"
        default ""
    choice
        prompt "Board"
        default TT_BOARD_CUSTOM
        config TT_BOARD_CUSTOM
            bool "Custom"
{{BOARD_CONFIGS}}
        help
            Select a board/hardware configuration.
            Use TT_BOARD_CUSTOM if you will manually configure the board in your project.
    endchoice

    config TT_SPLASH_DURATION
        int "Splash Duration (ms)"
        default 1000
        range 0 3000
        help
            The minimum time to show the splash screen in milliseconds.
            When set to 0, startup will continue to desktop as soon as boot operations are finished.
endmenu
```

## Libraries/esp_lvgl_port/test_apps/simd/main/Kconfig.projbuild
```kconfig
# Creating CONFIG_LV_DRAW_SW_ASM_CUSTOM avaliable in lvgl Kconfig to enable assembler source files by deafult

config LV_DRAW_SW_ASM_CUSTOM
    bool
    default y
```

## Libraries/esp_lvgl_port/test_apps/simd/sdkconfig.defaults
```kconfig
CONFIG_ESP_TASK_WDT=n
CONFIG_OPTIMIZATION_LEVEL_RELEASE=y
CONFIG_COMPILER_OPTIMIZATION_PERF=y
```

## app-esp/Kconfig
```kconfig
# Kconfig file for Tactility example app
menu "Tactility App"
    choice
        prompt "Board"
        default TT_BOARD_CUSTOM

        config TT_BOARD_CUSTOM
            bool "Custom"
        config TT_BOARD_YELLOW_BOARD_24_CAP
            bool "Yellow Board (2.4\" capacitive)"
        config TT_BOARD_LILYGO_TDECK
            bool "LilyGo T-Deck"
        config TT_BOARD_M5STACK_CORE2
            bool "M5Stack Core2"
        config TT_BOARD_WAVESHARE_S3_TOUCH
            bool "Waveshare S3 Touch LCD 4.3\""
    endchoice
endmenu
```

## main/Kconfig
```kconfig
# Kconfig file for Tactility example app
menu "Tactility App"
    choice
        prompt "Board"
        default TT_BOARD_CUSTOM

        config TT_BOARD_CUSTOM
            bool "Custom"
        config TT_BOARD_YELLOW_BOARD_24_CAP
            bool "Yellow Board (2.4\" capacitive)"
        config TT_BOARD_LILYGO_TDECK
            bool "LilyGo T-Deck"
    endchoice
endmenu
```

## sdkconfig.defaults
```kconfig
# Software defaults
# Increase stack size for WiFi (fixes crash after scan)
CONFIG_ESP_SYSTEM_EVENT_TASK_STACK_SIZE=3072
CONFIG_ESP_MAIN_TASK_STACK_SIZE=5120
CONFIG_LV_FONT_MONTSERRAT_14=y
CONFIG_LV_FONT_MONTSERRAT_18=y
CONFIG_LV_USE_USER_DATA=y
CONFIG_LV_USE_FS_STDIO=y
CONFIG_LV_FS_STDIO_LETTER=65
CONFIG_LV_FS_STDIO_PATH=""
CONFIG_LV_FS_STDIO_CACHE_SIZE=4096
CONFIG_LV_USE_LODEPNG=y
CONFIG_LV_USE_BUILTIN_MALLOC=n
CONFIG_LV_USE_CLIB_MALLOC=y
CONFIG_LV_USE_MSGBOX=n
CONFIG_LV_USE_SPINNER=n
CONFIG_LV_USE_WIN=n
CONFIG_LV_USE_SNAPSHOT=y
CONFIG_FREERTOS_HZ=1000
CONFIG_FREERTOS_TASK_NOTIFICATION_ARRAY_ENTRIES=2
CONFIG_FREERTOS_SMP=n
CONFIG_FREERTOS_UNICORE=n
CONFIG_FREERTOS_TIMER_TASK_STACK_DEPTH=4096
CONFIG_FREERTOS_USE_TRACE_FACILITY=y
CONFIG_FATFS_LFN_HEAP=y
CONFIG_FATFS_VOLUME_COUNT=3
CONFIG_FATFS_SECTOR_512=y
CONFIG_WL_SECTOR_SIZE_512=y
CONFIG_WL_SECTOR_SIZE=512
CONFIG_WL_SECTOR_MODE_SAFE=y
CONFIG_WL_SECTOR_MODE=1
CONFIG_MBEDTLS_SSL_PROTO_TLS1_3=y

# Hardware defaults
CONFIG_PARTITION_TABLE_CUSTOM=y
CONFIG_PARTITION_TABLE_CUSTOM_FILENAME="partitions-4mb.csv"
CONFIG_PARTITION_TABLE_FILENAME="partitions-4mb.csv"
CONFIG_TT_BOARD_CUSTOM=y
# LVGL
CONFIG_LV_DISP_DEF_REFR_PERIOD=10
CONFIG_LV_THEME_DEFAULT_DARK=y
```
